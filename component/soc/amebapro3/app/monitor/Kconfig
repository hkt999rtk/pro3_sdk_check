## component/soc/amebapro3/project/project_vp/Kconfig
```kconfig
comment "--- --------------CPU config Start------------"

menu "CONFIG CHIP"
    config CPU_HAS_FPU_FOR_VP
        bool
        default y

    choice
        prompt "ArmCore"
        default ARM_CORE_CM4_FOR_VP
        config ARM_CORE_CM4_FOR_VP
            bool "ARM_CM4"
			
		if ARM_CORE_CM4_FOR_VP
			config ARM_CORE_CM4_VP_FOR_VP
				def_bool y		
		endif
		
    endchoice
endmenu

config SUPPORT_FS_RW_FOR_VP
        bool "Support File system R/W"
        select WHC_NONE_FOR_VP
        default n
		
config VP_MEDIA_EXAMPLE
        bool "Build VP Media Example"
        default n

config SUPPORT_UVC_TUNING_FOR_VP
        bool "Support UVC TUNING"
        select VP_MEDIA_EXAMPLE
        default n
```

## component/soc/amebapro3/swlib/Kconfig
```kconfig
menu "SWLIB Option"
    choice
        prompt "UNISTD MODE"
        default UNISTD_NATIVE
			config UNISTD_NATIVE
				bool "NATIVE"
			config UNISTD_NOSYS
				bool "NOSYS"
			config UNISTD_SEMIHOSTING
				bool "SEMIHOSTING"
    endchoice
endmenu
```

## component/soc/amebapro3/video/Kconfig
```kconfig
menu "CONFIG VIDEO MODULES"

    config VMODULE_AINR
        bool "AINR"
        default y

    config VMODULE_ENCODER
        bool "ENCODER"
        default y

    config VMODULE_ISP
        bool "ISP"
        default y

    config VMODULE_NN
        bool "NN"
        default y

    if VMODULE_NN
        menu "NN Options"
            config NNVMEM_NC_FOR_AP
                bool "NN Video Memory Non-Cacheable for AP"
                default y
            config NNVMEM_NC_FOR_VP
                bool "NN Video Memory Non-Cacheable for VP"
                default y

            config NN_FOR_AP
                bool "NN Driver Run on AP"
                default y
        endmenu
    endif

    config VMODULE_SENSOR
        bool "SENSOR"
        default y

    config VMODULE_GE
        bool "GE"
        default y

    config VMODULE_ADDREMAP
        bool "ADDREMAP"
        default n

    if !AMEBA_RLS
    config VMODULE_SWISP2ENC
        bool "SWISP2ENC"
        default n

    config VMODULE_TEMPLATE
        bool "TEMPLATE"
        default n

    config VMODULE_TS
        bool "TS"
        default n
    endif
endmenu
```
